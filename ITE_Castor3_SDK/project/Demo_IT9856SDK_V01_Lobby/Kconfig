## ITE_Castor3_SDK/project/Demo_IT9856SDK_V01_Lobby/Kconfig
```kconfig
#
# For a description of the syntax of this configuration file,
# see Documentation/kbuild/kconfig-language.txt.
#

mainmenu "Project Configuration"

config DOORBELL_LOBBY
    bool
    default y
    select HAVE_LCD
    select HAVE_GRAPHICS
    select HAVE_AUDIO
    select HAVE_VIDEO
    select HAVE_TWO_WIEGAND

config CMAKE_SOURCE_DIR
    string
    option env="CMAKE_SOURCE_DIR"

config DEF_CHIP_PKG_IT9856
    def_bool y

config DEF_CHIP_REV_A0
    def_bool y

config RAM_INIT_SCRIPT
    default "IT9850A0_360MHz.scr" if !ENABLE_ROTATE
    default "IT9850A0_360MHz_tiling_pitch2048.scr"  if ENABLE_ROTATE

config SET_ROTATE 
    int       
    default 0 if !ENABLE_ROTATE
    default 1 if ENABLE_ROTATE

config TILING_WIDTH_128
    int
    default 0

config WATCHDOG_ENABLE
    def_bool y

config DCPS_ENABLE
    def_bool y
    
config FONT_FILENAME
    default "wqyMicroHeiProportional.ttf"    

config XCPU_MSGQ
    def_bool y

config BACKLIGHT_ENABLE
    def_bool y

config BACKLIGHT_DUTY_CYCLES
    default "95, 92, 88, 82, 75, 65, 55, 40, 25, 5"

config BACKLIGHT_DEFAULT_DUTY_CYCLE
    default "5"

config GPIO_BACKLIGHT_PWM
    default "64"

config LCD_ENABLE
    def_bool y

config LCD_HEIGHT
    default "480"

config LCD_INIT_SCRIPT
    default "IT9850_LCD_800_480_Allentech_7inch_565.txt.in"

config CMDQ_ENABLE
    def_bool y

config M2D_ENABLE
    def_bool y

config JPEG_HW_ENABLE
    def_bool y

config AUDIO_ENABLE
    def_bool y

config DIALOGUE_PARAMETER_SET
    def_bool y

config AEC_ENABLE
    def_bool y

config SPEAKER_GAIN
    default "2"

config MIC_GAIN
    default "0"

config NOISE_GATE_ENABLE
    def_bool y

config NOISE_GATE_THRESHOLD
    default "0.3"

config SPK_EQUALIZER_ENABLE
    def_bool y

###############################################################
#Sound default setting
###############################################################

config AUDIO_DAC_MODULE
    default "itp_dac_alc5616.c"

config EQUALIZER_SPKGAIN_SET
    default "\"500:2:256 2500:0.5:256\""

config AEC_DELAY_MS
    default "45"


###############################################################
#Sound default setting end
###############################################################

config AUDIO_CODEC_MP3DEC
    def_bool y

config AUDIO_CODEC_AACDEC
    def_bool y

config AUDIO_CODEC_WAV
    def_bool y

config  AUDIO_CODEC_G711_ULAW
    def_bool y

config VIDEO_ENABLE
    def_bool y

config TS_MODULE_ENABLE
    def_bool y

config RTSP_CLIENT_ENABLE
    def_bool y

config DEF_PURE_TS_STREAM
    def_bool y

config KEYPAD_ENABLE
    def_bool y

config KEYPAD_MODULE
    default "itp_keypad_it7236.c"

config TOUCH_KEYPAD_SET_KEY_NUMBER_ENABLE
    def_bool y

config TOUCH_KEY_NUM
    default "16"

config GPIO_KEYPAD
    default "76"

config TOUCH_KEY_USE_I2C
    def_bool y

config DEF_TOUCH_I2C1
    def_bool y    

config KEYPAD_MAPPING_TABLE
    default "keypad_doorbell_lobby.inc"

config NOR_ENABLE
    def_bool y

config NOR_CACHE_SIZE
    default "0x200000"

config NOR_SHARE_GPIO
    def_bool n

config NOR_RESERVED_SIZE
    default "0x600000"

config NOR_PARTITION0
    def_bool y

config NOR_PARTITION0_SIZE
    default "0x800000"

config NOR_PARTITION1
    def_bool y

config NOR_PARTITION1_SIZE
    default "0xA0000"

config NOR_PARTITION2
    def_bool y

config SD0_ENABLE
    def_bool n

config GPIO_SD0_IO
    default "16, 17, 18, 19, 20, 21, -1, -1, -1, -1"

config USB0_ENABLE
    def_bool y

config MSC_ENABLE
    def_bool y

config FS_FAT
    def_bool y

config RTC_ENABLE
    def_bool y

config I2C0_ENABLE
    def_bool y

config DEF_IIC0_GPIO_CONFIG_2
    def_bool y

config I2C1_ENABLE
    def_bool y

config DEF_IIC1_GPIO_CONFIG_3
    def_bool y    

config I2S_ENABLE
    def_bool y

config DEF_I2S_USE_GPIO_MODE_2
    def_bool y

config I2S_SPDIF_ENABLE
    def_bool n

config UART1_ENABLE
    def_bool y

config GPIO_UART1_TX
    default "4"

config GPIO_UART1_RX
    default "-1"

config GPIO_SD0_CARD_DETECT
    default "15"

config GPIO_SD0_POWER_ENABLE
    default "22"

config GPIO_SD0_WRITE_PROTECT
    default "-1"

config SENSOR_ENABLE
    def_bool y

config DEF_SENSOR_PIXELPLUS_PO3100
    def_bool y

config DEF_SENSOR_FLICK_50HZ
     def_bool y

config WIEGAND_ENABLE
    def_bool y

config DEF_WIEGAND0_BIT_34
    def_bool y

config DEF_WIEGAND1_BIT_34
    def_bool y

config GPIO_RS485_0_TX_ENABLE
    default "100"

config GPIO_RS485_0_TX
    default "101"

config GPIO_RS485_0_RX
    default "102"

config POWER_SAVING_ENABLE
    def_bool y

config DEF_POWER_STANDBY
    def_bool y

config POWER_STANDBY_CPU_FREQ_RATIO
    default "15"

config POWER_STANDBY_BUS_FREQ_RATIO
    default "30"

config GPIO_ETHERNET_LINK
    default "32"

config GPIO_ETHERNET
    default "90, 33, 36, 93, 95, 94, 92, 91, 35, 34"

config SPI1_ENABLE
    default y

config SPI0_MOSI_GPIO
    default "18"

config SPI0_MISO_GPIO
    default "19"

config SPI0_CLOCK_GPIO
    default "20"

config SPI0_CHIP_SEL_GPIO
    default "14"

config SPI1_MOSI_GPIO
    default "83"

config SPI1_MISO_GPIO
    default "84"

config SPI1_CLOCK_GPIO
    default "82"

config SPI1_CHIP_SEL_GPIO
    default "85"

config WIEGAND0_GPIO0
    default "7"           

config WIEGAND0_GPIO1
    default "8"

config WIEGAND1_GPIO0
    default "5"           

config WIEGAND1_GPIO1
    default "6"
    
config NET_ENABLE
    def_bool y

config NET_ETHERNET
    def_bool y

config NET_ETHERNET_LINK_INTR
    def_bool y

config NET_ETHERNET_MAC_ADDR_RANDOM
    def_bool y

config NET_ETHERNET_MAC_ADDR_STORAGE
    def_bool y

config NET_ETHERNET_MAC_ADDR_POS
    default "0x70000"

config NET_ETHERNET_MAC_ADDR_UPGRADE
    def_bool y

config NET_MAC_CLOCK_INVERSE 
    default "1" 

config NET_MAC_CLOCK_DELAY 
    default "0x6F" 

config NET_HTTP
    def_bool y

config NET_FTP
    def_bool y

config TASK_DRIVE_PROBE
    def_bool y

config DEF_DBG_UART1
    def_bool y

config DBG_INIT_SCRIPT
    default "IT9850A0_360MHz.txt"

config DEF_BUILD_MINSIZEREL
    def_bool y

config SYSTEM_NAME
    default "ITE Doorbell (lobby)"

config FFMPEG_ENC
    def_bool y

config ITU_FT_CACHE_ENABLE
    def_bool y

config ITU_FT_CACHE_SIZE
    default "0xFA000"

config GCC_LTO
    def_bool y

config BUILD_INIPARSER
    def_bool y

config BUILD_ITU
    def_bool y

config BUILD_LINPHONE
    def_bool y

config BUILD_MICROHTTPD
    def_bool y

config BUILD_SDL
    def_bool y

config BUILD_SNTP
    def_bool y

config BUILD_UPGRADE
    def_bool y

config BUILD_XML2
    def_bool y

######################################################################
# Start of bootloader setting
######################################################################
config BOOTLOADER_ENABLE
    def_bool n

if BOOTLOADER_ENABLE && LCD_ENABLE

config BL_SHOW_LOGO 
    def_bool y 

config LCD_BOOT_BITMAP
    default "logo.bmp"

endif

if BOOTLOADER_ENABLE

config UPGRADE_BOOTLOADER
    def_bool y

config UPGRADE_IMAGE
    def_bool y

config UPGRADE_IMAGE_POS
    default "0x80000"

config UPGRADE_DATA
    def_bool y

if UPGRADE_DATA
config UPGRADE_PUBLIC
    def_bool y

config UPGRADE_TEMP
    def_bool y
endif

config UPGRADE_OPEN_FILE
    def_bool y

config UPGRADE_PARTITION
    def_bool y

config UPGRADE_DELETE_PKGFILE_AFTER_FINISH
    def_bool y

config UPGRADE_NOR_IMAGE
    def_bool y

config UPGRADE_NOR_IMAGE_SIZE
    default "0x1000000"

config UPGRADE_FILENAME
    default "LOBBY.PKG"

config UPGRADE_FILENAME_LIST
    default "LOBBY.PKG ADDRESS.PKG CARD.PKG"

config UPGRADE_NOR_IMAGE_FILENAME
    default "LOBBY.ROM"

config BL_LCD_CONSOLE
    def_bool y

config BL_ERR
    def_bool y

config BL_WARN
    def_bool y

config BL_INFO
    def_bool y

config BL_DBG
    def_bool y

endif
######################################################################
# End of bootloader setting
######################################################################

source "$CMAKE_SOURCE_DIR/sdk/Kconfig"

######################################################################
# Project Menu
######################################################################
menu "DoorbellLobby"
    config GUARD_ENABLE
        bool "Guard is enabled or not"
        default n
        help
            Guard is enabled or not
        help_cht
            開啟安防報警的功能。
        help_chs
            开启安防报警的功能。

    config GPIO_GUARD_SENSORS
        string "Guard sensor's GPIOs"
        depends on GUARD_ENABLE
        default "0"
        help
            Guard sensor's GPIOs
        help_cht
            安防報警感應器的 GPIO 號碼。
        help_chs
            安防报警传感器的 GPIO 号码。

    config WEBSERVER_PORT
        string "Web server port"
        default "80"
        help
            Web server port
        help_cht
            網頁伺服器埠號。
        help_chs
            网页服务器埠号。

    config SNTP_PORT
        string "SNTP port"
        default "49123"
        help
            SNTP port
        help_cht
            網路時間協議 (SNTP) 埠號。
        help_chs
            网络时间协议 (SNTP) 埠号。

    config SNTP_UPDATE_DELAY
        string "SNTP update delay"
        default "300"
        help
            How long to sync time with SNTP server in seconds. The minimum update time is 15 seconds.
        help_cht
            多久時間從 SNTP 伺服器更新時間，最小時間為 15 秒 （單位: 秒）
        help_chs
            多久时间从 SNTP 服务器更新时间，最小时间为 15 秒 （单位: 秒）

    config CHECK_FILES_CRC_ON_BOOTING
        bool "Checking files' CRC on booting time"
        default y
        help
            Checking files' CRC on booting time
        help_cht
            開啟開機時檢查檔案 CRC 值的功能。
        help_chs
            开启开机时检查档案 CRC 值的功能。

    config UDP_HEARTBEAT
        bool "UDP heartbeat is enabled or not"
        default y
        help
            UDP heartbeat is enabled or not
        help_cht
            開啟心跳包的功能。
        help_chs
            开启心跳包的功能。

    config UDP_HEARTBEAT_PORT
        string "UDP heartbeat port"
        depends on UDP_HEARTBEAT
        default "49201"
        help
            UDP heartbeat port number
        help_cht
            心跳包埠號。
        help_chs
            心跳包埠号。

    config CARDLIST_ENABLE
        bool "Card list is enabled or not"
        default y
        help
            Card list is enabled or not
        help_cht
            開啟門禁系統功能。
        help_chs
            开启门禁系统功能。

    config HW_VERSION
        string "Hardware version"
        default "V01"
        help
            Hardware version
        help_cht
            硬體版號。
        help_chs
            硬件版号。

    config SCREENSHOT_ENABLE
        bool "Screenshot is enabled or not"
        default n
        help
            Screenshot is enabled or not
        help_cht
            開啟螢幕擷取功能。
        help_chs
            开启屏幕撷取功能。

    config LOOP_DIALING
        bool "Loop dialing is enabled or not"
        default n
        help
            Loop dialing is enabled or not
        help_cht
            開啟循環撥號功能。
        help_chs
            开启循环拨号功能。

    config LOOP_DIALING_ADDRESS
        string "Loop dialiing address"
        depends on LOOP_DIALING
        default "01-01-10-01-01"
        help
            Loop dialiing address
        help_cht
            循環撥號房號。
        help_chs
            循环拨号房号。

    config REGISTER_SIP_SERVER
        bool "Register to SIP server or not"
        default n
        help
            Register to SIP server or not
        help_cht
            開啟註冊SIP SERVER功能。
        help_chs
            开启注册SIP SERVER功能。

    config CALL_SIP_SERVER
        bool "Calling to SIP server or not"
        default n
        help
            Calling to SIP server or not
        help_cht
            開啟呼叫SIP SERVER功能。
        help_chs
            开启呼叫SIP SERVER功能。

    choice
        prompt "Support ADV Mode for Screensaver"
        default RTSP_STREAMING if DEF_RTSP_STREAMING
        default DOWNLOAD_TO_SD_CARD if DEF_DOWNLOAD_TO_SD_CARD
        default RTSP_STREAMING
        help
            Support Advertisement Mode for Screensaver
        help_cht
            進入螢幕保護模式時，支援廣告播放。
        help_chs
            进入萤幕保护模式时，支援广告播放。

    config RTSP_STREAMING
        bool "RTSP Streaming"
        help
            Playing advertisement by RTSP streaming.
        help_cht
            串流播放模式。
        help_chs
            串流播放模式。

    config DOWNLOAD_TO_SD_CARD
        bool "Download to SD Card"
        help
            Advertisement is saved in SD Card by FTP downloading.
        help_cht
            廣告預先下載至SD卡。
        help_chs
            广告预先下载至SD卡。
            
    endchoice

    config DUMP_AEC_DATA
        bool "Dump AEC Voice Data"
        default n
        help
            Dump AEC voice data for observation.
        help_cht
            開啟錄製AEC通話聲音功能(實驗使用)。
        help_chs
            开启录制AEC通话声音功能(实验使用)。

endmenu
```
