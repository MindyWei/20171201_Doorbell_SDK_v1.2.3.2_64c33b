## ITE_Castor3_SDK/project/test_video/Kconfig
```kconfig
#
# For a description of the syntax of this configuration file,
# see Documentation/kbuild/kconfig-language.txt.
#

mainmenu "Project Configuration"

config TEST_VIDEO
    bool
    default y
    select HAVE_LCD
    select HAVE_GRAPHICS
    select HAVE_VIDEO
    select HAVE_AUDIO

config CMAKE_SOURCE_DIR
    string
    option env="CMAKE_SOURCE_DIR"

config DEF_CHIP_PKG_IT9856
    def_bool y

config DEF_CHIP_REV_A0
    def_bool y  

config RAM_SIZE
    default "0x4000000"

config RAM_INIT_SCRIPT
    default "IT9850A0_400MHz_tiling_pitch2048.scr"

config LCD_ENABLE
    def_bool y

config LCD_WIDTH
    default "800"

config LCD_HEIGHT
    default "480"
    
config LCD_PITCH
    default "1600"

config LCD_INIT_SCRIPT
    default "IT9850_LCD_800_480_Allentech_7inch_565.txt.in"

config BACKLIGHT_ENABLE
    def_bool y

config BACKLIGHT_DUTY_CYCLES
    default "95, 92, 88, 82, 75, 65, 55, 40, 25, 5"

config GPIO_BACKLIGHT_PWM
     default "64"

config BACKLIGHT_DEFAULT_DUTY_CYCLE
    default "5"
    
config CMDQ_ENABLE
    def_bool y

config M2D_ENABLE
    def_bool y

config JPEG_HW_ENABLE
    def_bool y
	
config UART1_ENABLE
    def_bool y

config GPIO_UART1_TX
    default "4"

config GPIO_UART1_RX
    default "-1"

config DEF_DBG_UART1
    def_bool y

config DBG_INIT_SCRIPT
    default "IT9850A0_400MHz.txt"

config AUDIO_ENABLE
    def_bool y
    
config AUDIO_DAC_MODULE
    default "itp_dac_alc5616.c"

config BUILD_FFMPEG
    def_bool y

config VIDEO_ENABLE
    def_bool y

config STC_ENABLE
    def_bool y

config FS_FAT
    def_bool y
    
config ITU_UCL_ENABLE
    def_bool y
    
config BUILD_INIPARSER
    def_bool y
    
config BUILD_ITU
    def_bool y

config BUILD_SDL
    def_bool y

config SD0_ENABLE
	def_bool y

config SD0_STATIC
	default n

config GPIO_SD0_CARD_DETECT
	default "98"

config GPIO_SD0_POWER_ENABLE
	default "99"

config GPIO_SD0_WRITE_PROTECT
	default "100"
	
config GPIO_SD0_IO
      default "16, 17, 18, 19, 20, 21, -1, -1, -1, -1"

config USB0_ENABLE
    def_bool y

config MSC_ENABLE
    def_bool y

config TASK_DRIVE_PROBE
    def_bool y

config I2S_ENABLE
    def_bool y

config I2S_USE_GPIO_MODE_2    
    def_bool y

config I2C0_ENABLE
    def_bool y

config DEF_IIC0_GPIO_CONFIG_2
	def_bool y    

config RECORD_VIDEO
    def_bool y

source "$CMAKE_SOURCE_DIR/sdk/Kconfig"

menu "Test H.264 / Mjpeg"

    choice
        prompt "Test H.264 / Mjpeg"
        default TEST_CONTAINER

    config TEST_ELEMENTARY
        bool "ElementaryStream format (h264, 264, etc)"

    config TEST_CONTAINER
        bool "Container format (MKV, MP4, etc)"
        
    config TEST_MJPEG
        bool "Container format (AVI)"
        
    #config TEST_GOLDEN
    #    bool "Golden bitstream file format (bmp)"

    endchoice

endmenu
```
